/ {
	amba_pl: amba_pl {
		ranges;
		compatible = "simple-bus";
		#address-cells = <1>;
		#size-cells = <1>;
		firmware-name = "design_1_wrapper.bit.bin";
		clocking0: clocking0 {
			compatible = "xlnx,fclk";
			assigned-clocks = <&clkc 15>;
			assigned-clock-rates = <100000000>;
			#clock-cells = <0>;
			clock-output-names = "fabric_clk";
			clocks = <&clkc 15>;
		};
		solve_top_0: solve_top@40000000 {
			compatible = "xlnx,solve-top-1.0";
			xlnx,ii = "127 , ~ , 1555";
			xlnx,machine = <64>;
			xlnx,ip-name = "solve_top";
			reg = <0x40000000 0x10000>;
			clocks = <&clkc 15>;
			xlnx,s-axi-ctrl-addr-width = <7>;
			xlnx,clk-period = <10>;
			xlnx,edk-iptype = "PERIPHERAL";
			status = "okay";
			clock-names = "ap_clk";
			xlnx,combinational = <0>;
			xlnx,s-axi-ctrl-data-width = <32>;
			xlnx,latency = <126>;
			xlnx,name = "solve_top_0";
		};
	};
};
